## meta-opencentauri/conf/machine/elegoo-centauri-carbon1.conf
```bitbake
#@TYPE: Machine
#@NAME: Elegoo Centauri Carbon 1
#@DESCRIPTION: Machine configuration for the Elegoo Centauri Carbon 1, based on the Allwinner R528 CPU

require conf/machine/include/sun8i.inc

DEFAULTTUNE = "cortexa7thf-neon-vfpv4"

KERNEL_DEVICETREE = "allwinner/elegoo-centauri-carbon1.dtb"
KERNEL_IMAGETYPE = "zImage"
UBOOT_ENTRYPOINT = "0x43000000"
SERIAL_CONSOLES = "115200;ttyS0"

UBOOT_MACHINE = "elegoo_centauri_carbon1_defconfig"

OVERLAYFS_ETC_MOUNT_POINT = "/data"
OVERLAYFS_ETC_DEVICE = "/dev/mmcblk0p10"
OVERLAYFS_ETC_FSTYPE ?= "ext4"
OVERLAYFS_ETC_CREATE_MOUNT_DIRS = "0"
```
